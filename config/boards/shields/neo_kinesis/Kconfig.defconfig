## config/boards/shields/neo_kinesis/Kconfig.defconfig
```kconfig
if SHIELD_NEO_KINESIS

config ZMK_KEYBOARD_NAME
    default "Neo Kinesis"

if USB_DEVICE_STACK

config USB_NRFX
	default y

endif # USB_DEVICE_STACK

config BT_CTLR
	default BT

config ZMK_BLE
	default y

config ZMK_USB
	default y

endif # SHIELD_NEO_KINESIS
```
